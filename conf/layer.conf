## conf/layer.conf
```bitbake
# We have a conf and classes directory, add to BBPATH
BBPATH .= ":${LAYERDIR}"

# We have recipes-* directories, add to BBFILES
BBFILES += "${LAYERDIR}/recipes-*/*/*.bb \
            ${LAYERDIR}/recipes-*/*/*.bbappend"

BBFILE_COLLECTIONS += "meta-pam"
BBFILE_PATTERN_meta-pam = "^${LAYERDIR}/"
BBFILE_PRIORITY_meta-pam = "20"

LAYERDEPENDS_meta-pam = "core mitysom"
LAYERSERIES_COMPAT_meta-pam = "scarthgap"
```
